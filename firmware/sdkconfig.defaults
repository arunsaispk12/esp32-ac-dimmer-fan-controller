## firmware/sdkconfig.defaults
```kconfig
#
# ESP32 AC Dimmer Fan Controller
# Default SDK Configuration
#
# This configuration optimizes the ESP32 for precise timing control
# required for AC phase-angle dimming applications
#

# Flash Configuration
CONFIG_ESPTOOLPY_FLASHMODE_QIO=y
CONFIG_ESPTOOLPY_FLASHFREQ_80M=y
CONFIG_ESPTOOLPY_FLASHSIZE_4MB=y

# CPU Configuration
# Use 240MHz for maximum timing precision
CONFIG_ESP_DEFAULT_CPU_FREQ_MHZ_240=y
CONFIG_ESP_DEFAULT_CPU_FREQ_MHZ=240

# FreeRTOS Configuration
# 1000Hz tick rate for better timing granularity
CONFIG_FREERTOS_HZ=1000

# Compiler Options
# Optimize for performance
CONFIG_COMPILER_OPTIMIZATION_PERF=y
CONFIG_COMPILER_OPTIMIZATION_LEVEL_RELEASE=y
CONFIG_COMPILER_OPTIMIZATION_LEVEL=2

# ESP Timer
# High resolution timer is critical for AC dimming
CONFIG_ESP_TIMER_PROFILING=n
CONFIG_ESP_TIMER_TASK_STACK_SIZE=4096

# Logging
CONFIG_LOG_DEFAULT_LEVEL_INFO=y
CONFIG_LOG_DEFAULT_LEVEL=3
CONFIG_LOG_MAXIMUM_LEVEL_VERBOSE=y

# GPIO
# No special configuration needed, using defaults

# Watchdog Timers
CONFIG_ESP_TASK_WDT=y
CONFIG_ESP_TASK_WDT_TIMEOUT_S=5
CONFIG_ESP_INT_WDT=y
CONFIG_ESP_INT_WDT_TIMEOUT_MS=300

# Memory
CONFIG_ESP_SYSTEM_EVENT_TASK_STACK_SIZE=2304
CONFIG_ESP_MAIN_TASK_STACK_SIZE=4096

# Brownout Detector
CONFIG_ESP_BROWNOUT_DET=y
CONFIG_ESP_BROWNOUT_DET_LVL_SEL_0=y
CONFIG_ESP_BROWNOUT_DET_LVL=0

# Serial Flasher Config
CONFIG_ESPTOOLPY_BAUD_921600B=y
CONFIG_ESPTOOLPY_BAUD=921600
CONFIG_ESPTOOLPY_MONITOR_BAUD_115200B=y
CONFIG_ESPTOOLPY_MONITOR_BAUD=115200

# Partition Table
CONFIG_PARTITION_TABLE_SINGLE_APP=y
CONFIG_PARTITION_TABLE_CUSTOM_FILENAME=""
CONFIG_PARTITION_TABLE_FILENAME="partitions_singleapp.csv"

# Power Management
# Disable automatic light sleep for timing precision
CONFIG_PM_ENABLE=n

# ESP32-specific
CONFIG_ESP32_DEFAULT_CPU_FREQ_240=y
CONFIG_ESP32_DEFAULT_CPU_FREQ_MHZ=240
CONFIG_ESP32_XTAL_FREQ_40=y
CONFIG_ESP32_XTAL_FREQ=40
```
